## arch/mips/mach-mt7621/Kconfig
```kconfig
menu "MediaTek MT7621 platform"
	depends on MACH_MT7621

config SYS_SOC
	default "mt7621"

config SYS_DCACHE_SIZE
	default 32768

config SYS_DCACHE_LINE_SIZE
	default 32

config SYS_ICACHE_SIZE
	default 32768

config SYS_ICACHE_LINE_SIZE
	default 32

config SOC_MT7621
	bool
	select TARGET_MT7621
	help
	  Support MediaTek MT7621 SoC.

config SYS_TEXT_BASE
	default 0x80200000

config START_S_PATH
	string
	default "arch/mips/mach-mt7621"

config SPL_START_S_PATH
	string
	default "arch/mips/mach-mt7621/spl"

config SPL_TEXT_BASE
	hex
	default 0x80100000

config TPL_TEXT_BASE
	hex
	default 0xbfc00000

choice
	prompt "Board select"

config BOARD_MT7621_RFB
	bool "MT7621 reference board"
	select SOC_MT7621

config BOARD_MT7621_NAND_RFB
	bool "MT7621 reference board (NAND)"
	select SOC_MT7621

config BOARD_MT7621_NOR_TEMPLATE
	bool "MT7621 Template for NOR Flash"
	select SOC_MT7621

config BOARD_MT7621_NAND_TEMPLATE
	bool "MT7621 Template for NAND Flash"
	select SOC_MT7621

endchoice

menu "MT7621 GPIO Pin Mapping"
	depends on MACH_MT7621

config MT7621_SYS_LED
	bool "Enable System LED"
	default y
config MT7621_SYS_LED_PIN
	int "System LED GPIO Pin Number"
	depends on MT7621_SYS_LED
config MT7621_SYS_LED_LEVEL
	int "System LED Trigger Level"
	depends on MT7621_SYS_LED
	default 0
	range 0 1
	help
	  0:low 1:high

config MT7621_PWR_LED
	bool "Enable Power LED"
	default n
config MT7621_PWR_LED_PIN
	int "Power LED GPIO Pin Number"
	depends on MT7621_PWR_LED
config MT7621_PWR_LED_LEVEL
	int "Power LED Trigger Level"
	depends on MT7621_PWR_LED
	default 0
	range 0 1

config MT7621_EXTRA_GPIO1
	bool "Enable Init Extra GPIO 1"
	default n
config MT7621_EXTRA_GPIO1_PIN
	int "Extra GPIO 1 Pin Number"
	depends on MT7621_EXTRA_GPIO1
config MT7621_EXTRA_GPIO1_LEVEL
	int "Extra GPIO 1 Default Level"
	depends on MT7621_EXTRA_GPIO1
	default 1
	range 0 1

config MT7621_EXTRA_GPIO2
	bool "Enable Init Extra GPIO 2"
	default n
config MT7621_EXTRA_GPIO2_PIN
	int "Extra GPIO 2 Pin Number"
	depends on MT7621_EXTRA_GPIO2
config MT7621_EXTRA_GPIO2_LEVEL
	int "Extra GPIO 2 Default Level"
	depends on MT7621_EXTRA_GPIO2
	default 1
	range 0 1

config MT7621_EXTRA_GPIO3
	bool "Enable Init Extra GPIO 3"
	default n
config MT7621_EXTRA_GPIO3_PIN
	int "Extra GPIO 3 Pin Number"
	depends on MT7621_EXTRA_GPIO3
config MT7621_EXTRA_GPIO3_LEVEL
	int "Extra GPIO 3 Default Level"
	depends on MT7621_EXTRA_GPIO3
	default 1
	range 0 1

config MT7621_EXTRA_GPIO4
	bool "Enable Init Extra GPIO 4"
	default n
config MT7621_EXTRA_GPIO4_PIN
	int "Extra GPIO 4 Pin Number"
	depends on MT7621_EXTRA_GPIO4
config MT7621_EXTRA_GPIO4_LEVEL
	int "Extra GPIO 4 Default Level"
	depends on MT7621_EXTRA_GPIO4
	default 1
	range 0 1

config MT7621_EXTRA_GPIO5
	bool "Enable Init Extra GPIO 5"
	default n
config MT7621_EXTRA_GPIO5_PIN
	int "Extra GPIO 5 Pin Number"
	depends on MT7621_EXTRA_GPIO5
config MT7621_EXTRA_GPIO5_LEVEL
	int "Extra GPIO 5 Default Level"
	depends on MT7621_EXTRA_GPIO5
	default 1
	range 0 1

config MT7621_RST_BTN
	bool "Enable Reset Button"
	default y
config MT7621_RST_BTN_PIN
	int "Reset Button GPIO Pin Number"
	depends on MT7621_RST_BTN
config MT7621_RST_BTN_LEVEL
	int "Reset Button Trigger Level"
	depends on MT7621_RST_BTN
	default 0
	range 0 1
	help
	  0:low 1:high

config MT7621_WPS_BTN
	bool "Enable WPS Button"
	default n
config MT7621_WPS_BTN_PIN
	int "WPS Button GPIO Pin Number"
	depends on MT7621_WPS_BTN
config MT7621_WPS_BTN_LEVEL
	int "WPS Button Trigger Level"
	depends on MT7621_WPS_BTN
	default 0
	range 0 1

endmenu

config SPL_ALIGN_TO
	hex "SPL alignment size"
	default 0x10000 if SPI_BOOT
	default 0x20000 if NAND_BOOT
	help
	  Pad the SPL part to the closest size which is aligned with
	  this size.
	  Set to 0 if no padding is needed.

config MAX_U_BOOT_SIZE
	hex "Maximum U-Boot size"
	default 0x30000 if SPI_BOOT
	default 0x80000 if NAND_BOOT
	help
	  Maximum U-Boot size for SPL to search for the U-Boot SPL image

config MT7621_MEMTEST
	bool "Do optional memtest after DRAM initialization"
	depends on MACH_MT7621

config MT7621_SINGLE_CORE
	bool "Force to use single MIPS core"
	depends on MACH_MT7621
	default n

config MT7621_SINGLE_VPE
	bool "Force to use single VPE per core"
	depends on MACH_MT7621
	default n

config MT7621_LEGACY_DRAMC_BIN
	bool "Use legacy DDR initialization"
	depends on MACH_MT7621
	default n

source "arch/mips/mach-mt7621/dramc-legacy/Kconfig"
source "arch/mips/mach-mt7621/dramc/Kconfig"


source "board/ralink/mt7621_rfb/Kconfig"
source "board/ralink/mt7621_nand_rfb/Kconfig"


endmenu
```

## arch/mips/mach-mt7621/dramc-legacy/Kconfig
```kconfig
menu "CPU & DDR configuration"
	depends on MT7621_LEGACY_DRAMC_BIN

config MT7621_CPU_FREQ_LEGACY
	int "CPU Frequency (MHz)"
	range 400 1200
	default 880

choice
	prompt "DRAM Frequency"
	default MT7621_DRAM_FREQ_1200_LEGACY

config MT7621_DRAM_FREQ_400_LEGACY
	bool "400MHz"

config MT7621_DRAM_FREQ_800_LEGACY
	bool "800MHz"

config MT7621_DRAM_FREQ_1066_LEGACY
	bool "1066MHz"

config MT7621_DRAM_FREQ_1200_LEGACY
	bool "1200MHz"

endchoice

choice
	prompt "Prefered DDR2 init parameters"
	default MT7621_DRAM_DDR2_1024M_LEGACY

config MT7621_DRAM_DDR2_512M_LEGACY
	bool "64MB"

config MT7621_DRAM_DDR2_1024M_LEGACY
	bool "128MB"

config MT7621_DRAM_DDR2_512M_W9751G6KB_A02_1066MHZ_LEGACY
	bool "W9751G6KB_A02 @ 1066MHz (64MB)"

config MT7621_DRAM_DDR2_1024M_W971GG6KB25_800MHZ_LEGACY
	bool "W971GG6KB25 @ 800MHz (128MB)"

config MT7621_DRAM_DDR2_1024M_W971GG6KB18_1066MHZ_LEGACY
	bool "W971GG6KB18 @ 1066MHz (128MB)"

endchoice

choice
	prompt "Prefered DDR3 init parameters"
	default MT7621_DRAM_DDR3_2048M_LEGACY

config MT7621_DRAM_DDR3_1024M_LEGACY
	bool "128MB"

config MT7621_DRAM_DDR3_1024M_KGD_LEGACY
	bool "128MB KGD"

config MT7621_DRAM_DDR3_2048M_LEGACY
	bool "256MB"

config MT7621_DRAM_DDR3_4096M_LEGACY
	bool "512MB"

endchoice

config MT7621_DRAMC_DEBUG_LEGACY
	bool "Enable verbose output during DRAMC initialization"
	default y

endmenu
```

## arch/mips/mach-mt7621/dramc/Kconfig
```kconfig
menu "CPU & DDR configuration"
	depends on !MT7621_LEGACY_DRAMC_BIN

config MT7621_CPU_FREQ
	int "CPU Frequency (MHz)"
	range 400 1200
	default 880

choice
	prompt "DRAM speed"
	default MT7621_DRAM_FREQ_1200

config MT7621_DRAM_FREQ_400
	bool "400MT/s"

config MT7621_DRAM_FREQ_800
	bool "800MT/s"

config MT7621_DRAM_FREQ_1066
	bool "1066MT/s"

config MT7621_DRAM_FREQ_1200
	bool "1200MT/s"

endchoice

config MT7621_DRAM_FREQ
	int
	default "400" if MT7621_DRAM_FREQ_400
	default "800" if MT7621_DRAM_FREQ_800
	default "1066" if MT7621_DRAM_FREQ_1066
	default "1200" if MT7621_DRAM_FREQ_1200
	default "1200"

#config MT7621_DRAM_FREQ_TUNE
#	int "DRAM speed tune"
#	default 0
#	help
#	  This option is used to tune the DRAM frequency and will only take
#	  effect if the xtal clock is 40MHz.
#	  The final DRAM freq will be: DRAM_FREQ + 80 * DRAM_FREQ_TUNE.
#	  e.g.: if DRAM_FREQ == 1200, DRAM_FREQ_TUNE == 1, final DRAM clock
#	  will be 640MHz, and DRAM speed will be 1280MT/s
choice
	prompt "Prefered DDR2 init parameters"
	default MT7621_DRAM_DDR2_1024M

config MT7621_DRAM_DDR2_512M
	bool "64MB"

config MT7621_DRAM_DDR2_1024M
	bool "128MB"

config MT7621_DRAM_DDR2_512M_W9751G6KB_A02_1066MHZ
	bool "W9751G6KB_A02 @ 1066MHz (64MB)"

config MT7621_DRAM_DDR2_1024M_W971GG6KB25_800MHZ
	bool "W971GG6KB25 @ 800MHz (128MB)"

config MT7621_DRAM_DDR2_1024M_W971GG6KB18_1066MHZ
	bool "W971GG6KB18 @ 1066MHz (128MB)"

endchoice

choice
	prompt "Prefered DDR3 init parameters"
	default MT7621_DRAM_DDR3_2048M

config MT7621_DRAM_DDR3_1024M
	bool "128MB"

config MT7621_DRAM_DDR3_1024M_KGD
	bool "128MB KGD"

config MT7621_DRAM_DDR3_2048M
	bool "256MB"

config MT7621_DRAM_DDR3_4096M
	bool "512MB"

endchoice

config MT7621_DRAMC_DEBUG
	bool "Enable verbose output during DRAMC initialization"
	default y

endmenu
```

## board/ralink/common/Kconfig
```kconfig
config MTKAUTOBOOT_DELAY
	int "Delay for mtkautoboot command (seconds)"
	range 1 60
	default 3
	help
	  This is the default delay value for mtkautoboot command.
	  It can be overrided by environment variable "mtkautoboot.delay"

config MTK_DUAL_IMAGE_SUPPORT
	bool "Enable dual image support"
	default n
	help
	  Dual image support provides a way to protect the image from being
	  damaged. When enabled, image check will be performed before booting.
	  Both main image and backup image will be checked. If one of them has
	  been damaged, the other one will replace it.

config MTK_DUAL_IMAGE_PARTNAME_MAIN
	string "MTD partition name of the main image"
	default "firmware"
	depends on MTK_DUAL_IMAGE_SUPPORT
	help
	  The MTD partition name of the main image. Normally it will be
	  "firmware", and is the image to be booted.

config MTK_DUAL_IMAGE_PARTNAME_BACKUP
	string "MTD partition name of the backup image"
	default "firmware_backup"
	depends on MTK_DUAL_IMAGE_SUPPORT
	help
	  The MTD partition name of the backup image.

config MTK_DUAL_IMAGE_UPGRADE_BACKUP
	bool "Update backup image after upgrading main image"
	default y
	depends on MTK_DUAL_IMAGE_SUPPORT
	help
	  Select this if you want keep the backup image synced with the main
	  image. If selected, the backup image MTD partition will be erase
	  after successfully upgraded the main image, which allows the
	  backup image to be updated in next dual image checking stage.
```

## board/ralink/mt7621_nand_rfb/Kconfig
```kconfig
if BOARD_MT7621_NAND_RFB

config SYS_VENDOR
	default "ralink"

config SYS_BOARD
	default "mt7621_nand_rfb"

config SYS_CONFIG_NAME
	default "mt7621_nand"

config CRC32C_BE
	bool
	default y

config ENABLE_NAND_NMBM
	bool "Enable NAND bad block mapping management"
	default n
	select MTD_DEVICE
	select NMBM
	select NMBM_MTD
	help
	  Select this if you want to use bad block management to handle
	  bad blocks marked druing factory production, and to handle new
	  bad blocks during use.
	  Enabling this option will create a MTD translation layer on
	  the original MTD of the NAND device.

config NMBM_MAX_RATIO
	int "Default ratio for reserved block for management (N/16)"
	range 1 8
	default 1
	depends on ENABLE_NAND_NMBM
	help
	  This option determines how many blocks at the high adress of NAND
	  can be used for NMBM. For a large size NAND, 1/16 of total blocks
	  are still too large for NMBM. For this situation please set
	  CONFIG_NMBM_MAX_BLOCKS to a proper value to limit the maximum
	  reserved blocks.

config NMBM_MAX_BLOCKS
	int "Maximum blocks allowed for reserved block for management"
	range 32 2147483647
	default 256
	depends on ENABLE_NAND_NMBM
	help
	  This option is applied after NMBM_MAX_RATIO to ensure maximum
	  blocks reserved block for NMBM will not exceed the value set by
	  this option.

config DEFAULT_NAND_KERNEL_OFFSET
	hex "Default kernel offset in the NAND"
	default 0x140000
	help
	  This is the fallback value if mtkboardboot command can't
	  boot from MTD partition directly.

source "board/ralink/common/Kconfig"

endif
```

## board/ralink/mt7621_rfb/Kconfig
```kconfig
if BOARD_MT7621_RFB || BOARD_MT7621_NOR_TEMPLATE || \
	BOARD_ASUS_RTAC1200GU || BOARD_DLINK_DIR878A1 || \
	BOARD_LINKSURE_SG5 || BOARD_MERCURY_MAC2600R || \
	BOARD_SKSPRUCE_WIA330010 || BOARD_ZTE_E8820V2

config SYS_VENDOR
	default "ralink"

config SYS_BOARD
	default "mt7621_rfb"

config SYS_CONFIG_NAME
	default "mt7621"

config DEFAULT_NOR_KERNEL_OFFSET
	hex "Default kernel offset in the NOR"
	default 0x50000
	help
	  This is the fallback value if mtkboardboot command can't
	  retrive the kernel offset from mtdparts.

source "board/ralink/common/Kconfig"

endif
```

## configs/h3c_tx1801-plus_defconfig
```kconfig
CONFIG_MIPS=y
CONFIG_SPL_LDSCRIPT="arch/$(ARCH)/mach-mt7621/spl/u-boot-nand-spl.lds"
CONFIG_SPL_SERIAL_SUPPORT=y
CONFIG_ENV_SIZE=0x20000
CONFIG_SPL_SYS_MALLOC_F_LEN=0x100000
CONFIG_DEBUG_UART_BOARD_INIT=y
CONFIG_DEBUG_UART_BASE=0xbe000c00
CONFIG_DEBUG_UART_CLOCK=50000000
CONFIG_MACH_MT7621=y
CONFIG_BOARD_H3C_TX1801_PLUS=y
CONFIG_MT7621_DRAM_INIT_USER_PARAM_FIRST=y
CONFIG_MTKAUTOBOOT_DELAY=1
CONFIG_DEFAULT_NAND_KERNEL_OFFSET=0x200000
CONFIG_MIPS_BOOT_FDT=y
CONFIG_DEBUG_UART=y
# CONFIG_LOCALVERSION_AUTO is not set
CONFIG_NR_DRAM_BANKS=1
# CONFIG_EXPERT is not set
CONFIG_FIT=y
# CONFIG_ARCH_FIXUP_FDT_MEMORY is not set
CONFIG_NAND_BOOT=y
CONFIG_BOOTDELAY=0
CONFIG_USE_BOOTCOMMAND=y
CONFIG_BOOTCOMMAND="mtkautoboot"
CONFIG_SYS_CONSOLE_INFO_QUIET=y
CONFIG_DISPLAY_CPUINFO=y
CONFIG_LAST_STAGE_INIT=y
CONFIG_SPL_NAND_SUPPORT=y
CONFIG_SPL_PAYLOAD="u-boot-lzma.img"
CONFIG_SPL_YMODEM_SUPPORT=y
CONFIG_HUSH_PARSER=y
CONFIG_CMD_BOOTMENU=y
# CONFIG_CMD_ELF is not set
# CONFIG_CMD_XIMG is not set
CONFIG_CMD_MD5SUM=y
# CONFIG_CMD_FLASH is not set
CONFIG_CMD_GPIO=y
CONFIG_CMD_TFTPPUT=y
# CONFIG_CMD_NFS is not set
CONFIG_CMD_MTDPARTS=y
CONFIG_MTDIDS_DEFAULT="nand0=nand0"
CONFIG_MTDPARTS_DEFAULT="mtdparts=nand0:512k(u-boot),512k(u-boot-env),512k(exp),512k(factory),-(firmware)"
# CONFIG_PARTITIONS is not set
CONFIG_OF_CONTROL=y
CONFIG_OF_EMBED=y
CONFIG_DEFAULT_DEVICE_TREE="h3c,tx1801-plus"
CONFIG_NET_RANDOM_ETHADDR=y
# CONFIG_DM_WARN is not set
# CONFIG_OF_TRANSLATE is not set
CONFIG_DM_GPIO=y
CONFIG_MT7621_GPIO=y
CONFIG_LED=y
CONFIG_LED_GPIO=y
CONFIG_MTD=y
CONFIG_MTD_PARTITIONS=y
CONFIG_NAND_MT7621=y
CONFIG_SPL_NAND_MT7621=y
CONFIG_DM_ETH=y
CONFIG_MT7621_ETH=y
CONFIG_PINCTRL=y
CONFIG_PINCONF=y
CONFIG_PINCTRL_MT7621=y
CONFIG_DM_RESET=y
CONFIG_MT7621_RESET=y
CONFIG_DM_SERIAL=y
CONFIG_DEBUG_UART_MTK=y
CONFIG_DEBUG_UART_SHIFT=2
CONFIG_MTK_SERIAL=y
CONFIG_LZMA=y
CONFIG_SPL_LZMA=y
CONFIG_WEBUI_FAILSAFE=y
CONFIG_WEBUI_FAILSAFE_ON_AUTOBOOT_FAIL=y
CONFIG_FAILSAFE_ON_BUTTON=y
```
