## configs/mercury_mac2600r_defconfig
```kconfig
CONFIG_MIPS=y
CONFIG_TPL_MAX_SIZE=65536
CONFIG_SPL_SERIAL_SUPPORT=y
CONFIG_TPL_LIBGENERIC_SUPPORT=y
CONFIG_ENV_SIZE=0x10000
CONFIG_ENV_OFFSET=0x30000
CONFIG_SPL_SYS_MALLOC_F_LEN=0x100000
CONFIG_DEBUG_UART_BOARD_INIT=y
CONFIG_DEBUG_UART_BASE=0xbe000c00
CONFIG_DEBUG_UART_CLOCK=50000000
CONFIG_MACH_MT7621=y
CONFIG_BOARD_MERCURY_MAC2600R=y
CONFIG_MT7621_DRAM_INIT_USER_PARAM_FIRST=y
CONFIG_MT7621_DRAM_DDR3_1024M=y
CONFIG_MTKAUTOBOOT_DELAY=1
CONFIG_ROM_EXCEPTION_VECTORS=y
CONFIG_MIPS_BOOT_FDT=y
CONFIG_DEBUG_UART=y
# CONFIG_LOCALVERSION_AUTO is not set
CONFIG_NR_DRAM_BANKS=1
# CONFIG_EXPERT is not set
CONFIG_FIT=y
# CONFIG_ARCH_FIXUP_FDT_MEMORY is not set
CONFIG_SPI_BOOT=y
CONFIG_BOOTDELAY=0
CONFIG_USE_BOOTCOMMAND=y
CONFIG_BOOTCOMMAND="mtkautoboot"
CONFIG_SYS_CONSOLE_INFO_QUIET=y
CONFIG_DISPLAY_CPUINFO=y
CONFIG_LAST_STAGE_INIT=y
CONFIG_SPL_PAYLOAD="u-boot-lzma.img"
CONFIG_SPL_YMODEM_SUPPORT=y
CONFIG_TPL=y
CONFIG_TPL_NEEDS_SEPARATE_TEXT_BASE=y
CONFIG_HUSH_PARSER=y
CONFIG_CMD_BOOTMENU=y
# CONFIG_CMD_ELF is not set
# CONFIG_CMD_XIMG is not set
CONFIG_CMD_MD5SUM=y
# CONFIG_CMD_FLASH is not set
CONFIG_CMD_GPIO=y
CONFIG_CMD_SF=y
CONFIG_CMD_TFTPPUT=y
# CONFIG_CMD_NFS is not set
CONFIG_CMD_MTDPARTS=y
CONFIG_MTDIDS_DEFAULT="nor0=raspi"
CONFIG_MTDPARTS_DEFAULT="mtdparts=raspi:192k(u-boot),64k(u-boot-env),64k(factory),-(firmware)"
# CONFIG_PARTITIONS is not set
CONFIG_OF_CONTROL=y
CONFIG_OF_EMBED=y
CONFIG_DEFAULT_DEVICE_TREE="mercury,mac2600r"
CONFIG_ENV_IS_IN_SPI_FLASH=y
CONFIG_ENV_SECT_SIZE=0x10000
CONFIG_NET_RANDOM_ETHADDR=y
# CONFIG_DM_WARN is not set
# CONFIG_OF_TRANSLATE is not set
CONFIG_DM_GPIO=y
CONFIG_MT7621_GPIO=y
CONFIG_LED=y
CONFIG_LED_GPIO=y
CONFIG_MTD=y
CONFIG_MTD_PARTITIONS=y
CONFIG_DM_SPI_FLASH=y
CONFIG_SPI_FLASH=y
CONFIG_SPI_FLASH_BAR=y
CONFIG_SPI_FLASH_EON=y
CONFIG_SPI_FLASH_GIGADEVICE=y
CONFIG_SPI_FLASH_ISSI=y
CONFIG_SPI_FLASH_MACRONIX=y
CONFIG_SPI_FLASH_SPANSION=y
CONFIG_SPI_FLASH_STMICRO=y
CONFIG_SPI_FLASH_SST=y
CONFIG_SPI_FLASH_WINBOND=y
CONFIG_SPI_FLASH_XMC=y
# CONFIG_SPI_FLASH_USE_4K_SECTORS is not set
CONFIG_SPI_FLASH_MTD=y
CONFIG_DM_ETH=y
CONFIG_MT7621_ETH=y
CONFIG_PINCTRL=y
CONFIG_PINCONF=y
CONFIG_PINCTRL_MT7621=y
CONFIG_DM_RESET=y
CONFIG_MT7621_RESET=y
CONFIG_DM_SERIAL=y
# CONFIG_TPL_DM_SERIAL is not set
CONFIG_DEBUG_UART_MTK=y
CONFIG_DEBUG_UART_SHIFT=2
CONFIG_MTK_SERIAL=y
CONFIG_SPI=y
CONFIG_DM_SPI=y
CONFIG_MT7621_SPI=y
CONFIG_LZMA=y
CONFIG_SPL_LZMA=y
CONFIG_WEBUI_FAILSAFE=y
CONFIG_WEBUI_FAILSAFE_ON_AUTOBOOT_FAIL=y
CONFIG_FAILSAFE_ON_BUTTON=y
```

## configs/mt7621_nand_ax_wax202_defconfig
```kconfig
CONFIG_MIPS=y
CONFIG_SPL_LDSCRIPT="arch/$(ARCH)/mach-mt7621/spl/u-boot-nand-spl.lds"
CONFIG_SPL_LIBCOMMON_SUPPORT=y
CONFIG_SPL_LIBGENERIC_SUPPORT=y
CONFIG_SPL_SERIAL_SUPPORT=y
CONFIG_SPL_SYS_MALLOC_F_LEN=0x100000
CONFIG_SPL=y
CONFIG_DEBUG_UART_BOARD_INIT=y
CONFIG_DEBUG_UART_BASE=0xbe000c00
CONFIG_DEBUG_UART_CLOCK=50000000
CONFIG_MACH_MT7621=y
CONFIG_BOARD_MT7621_NAND_RFB=y
CONFIG_MT7621_DRAM_DDR2_1024M=y
CONFIG_MT7621_DRAM_DDR3_4096M=y
CONFIG_MT7621_DRAMC_DEBUG=y
CONFIG_DEFAULT_NAND_KERNEL_OFFSET=0x180000
CONFIG_MIPS_BOOT_FDT=y
CONFIG_DEBUG_UART=y
CONFIG_NR_DRAM_BANKS=1
# CONFIG_EXPERT is not set
CONFIG_FIT=y
# CONFIG_ARCH_FIXUP_FDT_MEMORY is not set
CONFIG_NAND_BOOT=y
CONFIG_BOOTDELAY=0
CONFIG_USE_BOOTCOMMAND=y
CONFIG_BOOTCOMMAND="mtkautoboot"
CONFIG_DISPLAY_CPUINFO=y
CONFIG_SPL_NAND_SUPPORT=y
CONFIG_SPL_PAYLOAD="u-boot-lzma.img"
CONFIG_SPL_YMODEM_SUPPORT=y
CONFIG_CMD_BOOTMENU=y
# CONFIG_CMD_ELF is not set
# CONFIG_CMD_XIMG is not set
# CONFIG_CMD_FLASH is not set
CONFIG_CMD_GPIO=y
# CONFIG_CMD_NFS is not set
CONFIG_CMD_MTDPARTS=y
CONFIG_MTDIDS_DEFAULT="nand0=nand0"
CONFIG_MTDPARTS_DEFAULT="mtdparts=nand0:512k(u-boot),512k(u-boot-env),512k(factory),38912K(firmware),38912K(firmware_backup),13312K(CRP),4096K(Language)"
# CONFIG_PARTITIONS is not set
CONFIG_OF_CONTROL=y
CONFIG_OF_EMBED=y
CONFIG_DEFAULT_DEVICE_TREE="mt7621_nand_rfb"
CONFIG_ENV_IS_IN_NAND=y
CONFIG_NET_RANDOM_ETHADDR=y
# CONFIG_DM_WARN is not set
# CONFIG_OF_TRANSLATE is not set
CONFIG_DM_GPIO=y
CONFIG_MT7621_GPIO=y
CONFIG_MTD=y
CONFIG_MTD_PARTITIONS=y
CONFIG_NAND_MT7621=y
CONFIG_SPL_NAND_MT7621=y
CONFIG_DM_ETH=y
CONFIG_MT7621_ETH=y
CONFIG_PINCTRL=y
CONFIG_PINCONF=y
CONFIG_PINCTRL_MT7621=y
CONFIG_DM_RESET=y
CONFIG_MT7621_RESET=y
CONFIG_DM_SERIAL=y
CONFIG_DEBUG_UART_MTK=y
CONFIG_DEBUG_UART_SHIFT=2
CONFIG_MTK_SERIAL=y
CONFIG_LZMA=y
CONFIG_SPL_LZMA=y
CONFIG_CMD_TFTPSRV=y
CONFIG_CMD_NMRP=y
CONFIG_MTKAUTOBOOT_DELAY=1
CONFIG_MTK_DUAL_IMAGE_SUPPORT=y
CONFIG_MTK_DUAL_IMAGE_PARTNAME_MAIN="firmware"
CONFIG_MTK_DUAL_IMAGE_PARTNAME_BACKUP="firmware_backup"
CONFIG_MTK_DUAL_IMAGE_SQUASHFS_DATA_CHECK=y
# CONFIG_MTK_DUAL_IMAGE_RESTORE_KERNEL_ONLY is not set
CONFIG_AES=y
CONFIG_TW=y
CONFIG_NETGEAR_UPGRADE_MODEL_SET_WAX202=y
CONFIG_LED=y
# CONFIG_CMD_LED is not set
```

## configs/mt7621_nmbm_template_defconfig
```kconfig
CONFIG_MIPS=y
CONFIG_SPL_LDSCRIPT="arch/$(ARCH)/mach-mt7621/spl/u-boot-nand-spl.lds"
CONFIG_SPL_SERIAL_SUPPORT=y
CONFIG_ENV_SIZE=0x20000
CONFIG_ENV_OFFSET=0x80000
CONFIG_SPL_SYS_MALLOC_F_LEN=0x100000
CONFIG_DEBUG_UART_BOARD_INIT=y
CONFIG_DEBUG_UART_BASE=0xbe000c00
CONFIG_DEBUG_UART_CLOCK=50000000
CONFIG_MACH_MT7621=y
CONFIG_BOARD_MT7621_NAND_TEMPLATE=y
CONFIG_MT7621_LEGACY_DRAMC_BIN=y
# CONFIG_MT7621_DRAMC_DEBUG_LEGACY is not set
CONFIG_MTKAUTOBOOT_DELAY=1
CONFIG_ENABLE_NAND_NMBM=y
CONFIG_DEFAULT_NAND_KERNEL_OFFSET=0x180000
CONFIG_MIPS_BOOT_FDT=y
CONFIG_DEBUG_UART=y
# CONFIG_LOCALVERSION_AUTO is not set
CONFIG_NR_DRAM_BANKS=1
# CONFIG_EXPERT is not set
CONFIG_FIT=y
# CONFIG_ARCH_FIXUP_FDT_MEMORY is not set
CONFIG_NAND_BOOT=y
CONFIG_BOOTDELAY=0
CONFIG_USE_BOOTCOMMAND=y
CONFIG_BOOTCOMMAND="mtkautoboot"
CONFIG_SYS_CONSOLE_INFO_QUIET=y
CONFIG_DISPLAY_CPUINFO=y
CONFIG_LAST_STAGE_INIT=y
CONFIG_SPL_NAND_SUPPORT=y
CONFIG_SPL_PAYLOAD="u-boot-lzma.img"
CONFIG_SPL_YMODEM_SUPPORT=y
CONFIG_CMD_BOOTMENU=y
# CONFIG_CMD_ELF is not set
# CONFIG_CMD_XIMG is not set
# CONFIG_CMD_FLASH is not set
CONFIG_CMD_GPIO=y
CONFIG_CMD_NMBM=y
# CONFIG_CMD_NFS is not set
CONFIG_CMD_MTDPARTS=y
CONFIG_MTDIDS_DEFAULT="nmbm0=nmbm0"
# CONFIG_PARTITIONS is not set
CONFIG_OF_CONTROL=y
CONFIG_OF_EMBED=y
CONFIG_DEFAULT_DEVICE_TREE="mt7621_nand_template"
CONFIG_ENV_IS_IN_NMBM=y
CONFIG_ENV_SECT_SIZE=0x20000
CONFIG_NET_RANDOM_ETHADDR=y
# CONFIG_DM_WARN is not set
# CONFIG_OF_TRANSLATE is not set
CONFIG_DM_GPIO=y
CONFIG_MT7621_GPIO=y
CONFIG_MTD=y
CONFIG_MTD_PARTITIONS=y
CONFIG_NAND_MT7621=y
CONFIG_SPL_NAND_BASE_SIMPLE=y
CONFIG_DM_ETH=y
CONFIG_MT7621_ETH=y
CONFIG_PINCTRL=y
CONFIG_PINCONF=y
CONFIG_PINCTRL_MT7621=y
CONFIG_DM_RESET=y
CONFIG_MT7621_RESET=y
CONFIG_DM_SERIAL=y
CONFIG_DEBUG_UART_MTK=y
CONFIG_DEBUG_UART_SHIFT=2
CONFIG_MTK_SERIAL=y
CONFIG_LZMA=y
CONFIG_SPL_LZMA=y
CONFIG_WEBUI_FAILSAFE=y
CONFIG_WEBUI_FAILSAFE_ON_AUTOBOOT_FAIL=y
```

## configs/mt7621_rfb_defconfig
```kconfig
CONFIG_MIPS=y
CONFIG_TPL_MAX_SIZE=65536
CONFIG_SPL_SERIAL_SUPPORT=y
CONFIG_TPL_LIBGENERIC_SUPPORT=y
CONFIG_ENV_SIZE=0x10000
CONFIG_ENV_OFFSET=0x30000
CONFIG_SPL_SYS_MALLOC_F_LEN=0x100000
CONFIG_DEBUG_UART_BOARD_INIT=y
CONFIG_DEBUG_UART_BASE=0xbe000c00
CONFIG_DEBUG_UART_CLOCK=50000000
CONFIG_MACH_MT7621=y
CONFIG_MT7621_LEGACY_DRAMC_BIN=y
CONFIG_ROM_EXCEPTION_VECTORS=y
CONFIG_MIPS_BOOT_FDT=y
CONFIG_DEBUG_UART=y
CONFIG_NR_DRAM_BANKS=1
# CONFIG_EXPERT is not set
CONFIG_FIT=y
# CONFIG_ARCH_FIXUP_FDT_MEMORY is not set
CONFIG_SPI_BOOT=y
CONFIG_BOOTDELAY=0
CONFIG_USE_BOOTCOMMAND=y
CONFIG_BOOTCOMMAND="mtkautoboot"
CONFIG_DISPLAY_CPUINFO=y
CONFIG_SPL_PAYLOAD="u-boot-lzma.img"
CONFIG_SPL_YMODEM_SUPPORT=y
CONFIG_TPL=y
CONFIG_TPL_NEEDS_SEPARATE_TEXT_BASE=y
CONFIG_CMD_BOOTMENU=y
# CONFIG_CMD_ELF is not set
# CONFIG_CMD_XIMG is not set
# CONFIG_CMD_FLASH is not set
CONFIG_CMD_GPIO=y
CONFIG_CMD_SF=y
# CONFIG_CMD_NFS is not set
CONFIG_CMD_MTDPARTS=y
CONFIG_MTDIDS_DEFAULT="nor0=raspi"
CONFIG_MTDPARTS_DEFAULT="mtdparts=raspi:192k(u-boot),64k(u-boot-env),64k(factory),-(firmware)"
# CONFIG_PARTITIONS is not set
CONFIG_OF_CONTROL=y
CONFIG_OF_EMBED=y
CONFIG_DEFAULT_DEVICE_TREE="mt7621_nor_rfb"
CONFIG_ENV_IS_IN_SPI_FLASH=y
CONFIG_ENV_SECT_SIZE=0x10000
CONFIG_NET_RANDOM_ETHADDR=y
# CONFIG_DM_WARN is not set
# CONFIG_OF_TRANSLATE is not set
CONFIG_DM_GPIO=y
CONFIG_MT7621_GPIO=y
CONFIG_MTD=y
CONFIG_MTD_PARTITIONS=y
CONFIG_DM_SPI_FLASH=y
CONFIG_SPI_FLASH=y
CONFIG_SPI_FLASH_BAR=y
CONFIG_SPI_FLASH_EON=y
CONFIG_SPI_FLASH_GIGADEVICE=y
CONFIG_SPI_FLASH_ISSI=y
CONFIG_SPI_FLASH_MACRONIX=y
CONFIG_SPI_FLASH_SPANSION=y
CONFIG_SPI_FLASH_STMICRO=y
CONFIG_SPI_FLASH_SST=y
CONFIG_SPI_FLASH_WINBOND=y
# CONFIG_SPI_FLASH_USE_4K_SECTORS is not set
CONFIG_SPI_FLASH_MTD=y
CONFIG_DM_ETH=y
CONFIG_MT7621_ETH=y
CONFIG_PINCTRL=y
CONFIG_PINCONF=y
CONFIG_PINCTRL_MT7621=y
CONFIG_DM_RESET=y
CONFIG_MT7621_RESET=y
CONFIG_DM_SERIAL=y
# CONFIG_TPL_DM_SERIAL is not set
CONFIG_DEBUG_UART_MTK=y
CONFIG_DEBUG_UART_SHIFT=2
CONFIG_MTK_SERIAL=y
CONFIG_SPI=y
CONFIG_DM_SPI=y
CONFIG_MT7621_SPI=y
CONFIG_LZMA=y
CONFIG_SPL_LZMA=y
```

## failsafe/Kconfig
```kconfig
#
# Failsafe Web UI
#

menuconfig WEBUI_FAILSAFE
	bool "Enable Failsafe Web UI"
	select TCP
	select HTTPD
	default n
	help
	  Enable Web based failsafe UI

if WEBUI_FAILSAFE

config WEBUI_FAILSAFE_ON_AUTOBOOT_FAIL
	bool "Start Failsafe Web UI on autoboot failure"
	default n

config WEBUI_FAILSAFE_ON_BUTTON
	bool "Press and hold the reset button to enter the failsafe"
	depends on MT7621_RST_BTN
	default n

endif # WEBUI_FAILSAFE
```
